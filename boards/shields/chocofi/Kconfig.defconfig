## boards/shields/chocofi/Kconfig.defconfig
```kconfig
if SHIELD_CHOCOFI_DONGLE

# Name must be less than 16 characters long!
config ZMK_KEYBOARD_NAME
    default "Chocofi"

config ZMK_SPLIT_ROLE_CENTRAL
    default y

config ZMK_SPLIT_BLE_CENTRAL_PERIPHERALS
    default 2

config BT_MAX_CONN
    default 5

config BT_MAX_PAIRED
    default 5

endif

if SHIELD_CHOCOFI_LEFT || SHIELD_CHOCOFI_RIGHT

# Enable sleep support
config ZMK_SLEEP
    default y

# Sleep timeout of 30 mins
config ZMK_IDLE_SLEEP_TIMEOUT
    default 1800000

endif

if SHIELD_CHOCOFI_DONGLE || SHIELD_CHOCOFI_LEFT || SHIELD_CHOCOFI_RIGHT

# Enable split support
config ZMK_SPLIT
    default y

endif
```

## config/west.yml
```yaml
manifest:
  defaults:
    revision: v0.3
  remotes:
    - name: zmkfirmware
      url-base: https://github.com/zmkfirmware
    - name: caksoylar
      url-base: https://github.com/caksoylar
    - name: dhruvinsh
      url-base: https://github.com/dhruvinsh
    # Additional modules containing boards/shields/custom code can be listed here as well
    # See https://docs.zephyrproject.org/3.2.0/develop/west/manifest.html#projects
  projects:
    - name: zmk
      remote: zmkfirmware
      import: app/west.yml
    - name: zmk-rgbled-widget
      remote: caksoylar
    - name: zmk-tri-state
      remote: dhruvinsh
  self:
    path: config
```
